/*
 * USART1 hacia el ESP32-C3
 *   PA9  = TX (D8)   PA10 = RX (D2)
 */
&usart1 {
	pinctrl-0 = <&usart1_tx_pa9 &usart1_rx_pa10>;
	pinctrl-names = "default";
	current-speed = <115200>;
	status = "okay";
};
 
/*
 * I2C1 para los sensores (pines Arduino de la Nucleo)
 *   PB8 = SCL (D15)  PB9 = SDA (D14)
 */
&i2c1 {
	pinctrl-0 = <&i2c1_scl_pb8 &i2c1_sda_pb9>;
	pinctrl-names = "default";
	clock-frequency = <I2C_BITRATE_STANDARD>;   /* 100 kHz */
	status = "okay";
};
 
